/*
 * This program is free software; you can redistribute it and/or modify
 * it under the terms of the GNU General Public License as published by
 * the Free Software Foundation; either version 2 of the License, or
 * (at your option) any later version.
 *
 * This program is distributed in the hope that it will be useful,
 * but WITHOUT ANY WARRANTY; without even the implied warranty of
 * MERCHANTABILITY or FITNESS FOR A PARTICULAR PURPOSE.  See the
 * GNU General Public License for more details.
 */

/dts-v1/;
#include "rk3288-evb.dtsi"

/ {
	compatible = "rockchip,rk3288-evb-rk808", "rockchip,rk3288";
};

&i2c0 {
	rk808: rk808@1b {
		compatible = "rockchip,rk808";
		reg = <0x1b>;

		interrupt-parent = <&gpio0>;
		interrupts = <4 IRQ_TYPE_EDGE_FALLING>; /* gpio0_a */

		gpios = <&gpio0 0 0>; /* pmic_sleep */
	};
};
