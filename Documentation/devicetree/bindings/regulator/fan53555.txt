## Documentation/devicetree/bindings/regulator/fan53555.txt
```
Binding for Fairchild FAN53555 regulators

Required properties:
  - compatible: one of "fairchild,fan53555", "silergy,syr827", "silergy,syr828"
  - reg: I2C address

Optional properties:
  - fairchild,suspend-regulator: regulator number to use for suspend voltages
		possible values are either <0> or <1>
  - fairchild,slew-rate-microvolt: slew rate to use for positive voltage
		transistions in microvolts per us, possible values are:
		64000, 32000, 16000, 8000, 4000, 2000, 1000, 500
  - vin-supply: regulator supplying the vin pin

Example:

	regulator@40 {
		compatible = "fairchild,fan53555";
		regulator-name = "fan53555";
		regulator-min-microvolt = <1000000>;
		regulator-max-microvolt = <1800000>;
		vin-supply = <&parent_reg>;
		fairchild,suspend-regulator = <1>;
		fairchild,slew-rate-microvolt = <64000>;
	};
```

## Documentation/devicetree/bindings/thermal/iio-thermal.txt
```
Generic IIO channel thermal sensor bindings

compatible:
	Usage: required
	Type: string
	Desc: compatible string, must be "iio-thermal"

conversion-method:
	Usage: required
	Type: string
	Desc: How to convert IIO voltage values to temperature, one of:
		"interpolation" - interpolate between values in lookup table
		"scalar" - use values as multiplier and divisor

conversion-values:
	Usage: required
	Type: u32 array, 2-tuples
	Desc: lookup table for conversion, for conversion-method:
		"interpolation" - 2-tuples of < uV mK >; micro-volts to
				  milli-kelvin; table must ascend
		"scalar" - single scalar 2-tuple as < M D >; where:
			   mK = uV * M / D

io-channels:
	Usage: required
	Type: prop-encoded-array
	Desc: See bindings/iio/iio-bindings.txt; must be a voltage channel

Example:

vadc: some_vadc {
	compatible = "...";
	#io-channel-cells = <1>;
};

iio-thermal {
	compatible = "iio-thermal";
	io-channels = <&vadc 0>;
	conversion-method = "interpolation";
	conversion-values = <
		  30000 398200
		 385000 318200
		1738000 233200
	>;
};
```

## Documentation/devicetree/bindings/video/dw_hdmi-rockchip.txt
```
Rockchip specific extensions to the Synopsys Designware HDMI
================================

Required properties:
- compatible: "rockchip,rk3288-dw-hdmi";

- reg: physical base address of the controller and length
- reg-io-width: the width of the reg:1,2,4
- ddc-i2c-bus: the ddc i2c bus
- clocks: from common clock binding: handle to hdmi clock.
	of memory mapped region.
- clock-names: from common clock binding:
	Required elements: "iahp" "isfr"
- gpr: this soc should set GRF regs, so need get grf here.

- ports: contain a port node with endpoint definitions as defined in
  Documentation/devicetree/bindings/media/video-interfaces.txt.

Example:
hdmi: hdmi@ff980000 {
                compatible = "rockchip,rk3288-dw-hdmi";
                reg = <0xff980000 0x20000>;
                reg-io-width = <4>;
		ddc-i2c-bus = <&i2c5>;
                gpr = <&grf>;
                interrupts = <GIC_SPI 103 IRQ_TYPE_LEVEL_HIGH>;
                clocks = <&cru  PCLK_HDMI_CTRL>, <&cru SCLK_HDMI_HDCP>;
                clock-names = "iahb", "isfr";
                status = "disabled";
                ports {
                        hdmi_in: port {
                                #address-cells = <1>;
                                #size-cells = <0>;
                                hdmi_in_vopb: endpoint@0 {
                                        reg = <0>;
                                        remote-endpoint = <&vopb_out_hdmi>;
                                };
                                hdmi_in_vopl: endpoint@1 {
                                        reg = <1>;
                                        remote-endpoint = <&vopl_out_hdmi>;
                                };
                        };
                };
        };
```

## Documentation/devicetree/bindings/video/rockchip-edp.txt
```
Rockchip RK3288 EDP interface
================================

Required properties:
- compatible: "rockchip,rk3288-edp";

- reg: physical base address of the controller and length
- clocks: must include clock specifiers corresponding to entries in the
	clock-names property.
- clock-names: from common clock binding:
	Required elements: "dp"
			"phy"
			"pclk"
- resets: Must contain an entry for each entry in reset-names.
	See ../reset/reset.txt for details.
- reset-names: Must include the name "edp"
- rockchip,grf: phandle to the GRF syscon of the system.

Required nodes:

The lvds has two video ports as described by
	Documentation/devicetree/bindings/media/video-interfaces.txt.
Their connections are modeled using the OF graph bindings specified in
	Documentation/devicetree/bindings/graph.txt.

- video port 0 for the VOP inputs
- video port 1 for a panel as described by
	Documentation/devicetree/bindings/panel/simple-panel.txt

Example:
	edp: edp@ff970000 {
		compatible = "rockchip,rk3288-edp";
		reg = <0xff970000 0x4000>;
		interrupts = <GIC_SPI 98 IRQ_TYPE_LEVEL_HIGH>;
		clocks = <&cru SCLK_EDP>, <&cru SCLK_EDP_24M>, <&cru PCLK_EDP_CTRL>;
		clock-names = "dp", "phy", "pclk";
		rockchip,grf = <&grf>;
		resets = <&cru 111>;
		reset-names = "edp";
		rockchip,panel = <&panel>;
		ports {
			#address-cells = <1>;
			#size-cells = <0>;
			edp_in: port@0 {
				#address-cells = <1>;
				#size-cells = <0>;
				edp_in_vopb: endpoint@0 {
					reg = <0>;
					remote-endpoint = <&vopb_out_edp>;
				};
				edp_in_vopl: endpoint@1 {
					reg = <1>;
					remote-endpoint = <&vopl_out_edp>;
				};
			};
			edp_out: port@1 {
				reg = <1>;
				#address-cells = <1>;
				#size-cells = <0>;
				edp_out_panel: endpoint {
					remote-endpoint = <&panel_in>;
				};
			};
		};
	};
```

## Documentation/devicetree/bindings/video/rockchip-lvds.txt
```
Rockchip RK3288 LVDS interface
================================

Required properties:
- compatible: "rockchip,rk3288-lvds";

- reg: physical base address of the controller and length
	of memory mapped region.
- clocks: must include clock specifiers corresponding to entries in the
	clock-names property.
- clock-names: must contain "pclk_lvds"

- avdd1v0-supply: regulator phandle for 1.0V analog power
- avdd1v8-supply: regulator phandle for 1.8V analog power
- avdd3v3-supply: regulator phandle for 3.3V analog power

- rockchip,grf: phandle to the general register files syscon
- rockchip,panel: phandle to a panel node as described by
	Documentation/devicetree/bindings/panel/*

- rockchip,data-mapping: should be "vesa" or "jeida",
	This describes how the color bits are laid out in the
	serialized LVDS signal.
- rockchip,data-width : should be <18> or <24>;
- rockchip,output: should be "rgb", "lvds" or "duallvds",
	This describes the output face.

- ports: contain a port node with endpoint definitions as defined in
	Documentation/devicetree/bindings/media/video-interfaces.txt.

Example:
	lvds: lvds@ff96c000 {
		compatible = "rockchip,rk3288-lvds";
		rockchip,grf = <&grf>;
		reg = <0xff96c000 0x4000>;
		clocks = <&cru PCLK_LVDS_PHY>;
		clock-names = "pclk_lvds";
		avdd1v0-supply = <&vdd10_lcd>;
		avdd1v8-supply = <&vcc18_lcd>;
		avdd3v3-supply = <&vcca_33>;
		rockchip,panel = <&panel>;
		rockchip,data-mapping = "jeida";
		rockchip,data-width = <24>;
		rockchip,output = "rgb";
		ports {
			lvds_in: port {
				#address-cells = <1>;
				#size-cells = <0>;
				lvds_in_vopb: endpoint@0 {
					reg = <0>;
					remote-endpoint = <&vopb_out_lvds>;
				};
				lvds_in_vopl: endpoint@1 {
					reg = <1>;
					remote-endpoint = <&vopl_out_lvds>;
				};
			};
		};
	};
```

## drivers/gpu/drm/bridge/Kconfig
```kconfig
config DRM_PTN3460
	tristate "PTN3460 DP/LVDS bridge"
	depends on DRM
	select DRM_KMS_HELPER
	---help---

config DRM_DW_HDMI
	bool "Synopsys DesignWare High-Definition Multimedia Interface"
	depends on DRM
	select DRM_KMS_HELPER
```
